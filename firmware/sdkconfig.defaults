## firmware/sdkconfig.defaults
```kconfig
# CPU clock
CONFIG_ESP_DEFAULT_CPU_FREQ_MHZ_240=y

# USB Serial/JTAG CDC (ESP32-S3 内蔵コントローラ)
CONFIG_ESP_CONSOLE_USB_SERIAL_JTAG=y

# FreeRTOS tick rate (1ms 周期タスク用)
CONFIG_FREERTOS_HZ=1000

# NVS
CONFIG_NVS_ASSERT_ERROR_CHECK=n

# Logging
CONFIG_LOG_DEFAULT_LEVEL_INFO=y

# BLE-only NimBLE peripheral (one monitor connection)
CONFIG_BT_ENABLED=y
CONFIG_BT_BLUEDROID_ENABLED=n
CONFIG_BT_NIMBLE_ENABLED=y
CONFIG_BT_NIMBLE_MAX_CONNECTIONS=1
CONFIG_BT_NIMBLE_ROLE_CENTRAL=n
CONFIG_BT_NIMBLE_ROLE_PERIPHERAL=y
CONFIG_BT_NIMBLE_ROLE_BROADCASTER=n
CONFIG_BT_NIMBLE_ROLE_OBSERVER=n
CONFIG_BT_NIMBLE_NVS_PERSIST=y
CONFIG_BT_NIMBLE_SM_LEGACY=n
CONFIG_BT_NIMBLE_SM_SC=y
CONFIG_BT_NIMBLE_SM_LVL=2
CONFIG_BT_NIMBLE_SM_SC_ONLY=0
CONFIG_BT_NIMBLE_ATT_PREFERRED_MTU=185

# BLE + WiFi image needs the large single-app partition on 2MB flash.
CONFIG_PARTITION_TABLE_SINGLE_APP_LARGE=y
```

## firmware_test/sdkconfig.defaults
```kconfig
# CPU クロック
CONFIG_ESP_DEFAULT_CPU_FREQ_MHZ_240=y

# USB Serial/JTAG CDC (ESP32-S3 内蔵コントローラ)
CONFIG_ESP_CONSOLE_USB_SERIAL_JTAG=y
CONFIG_USB_SERIAL_JTAG_ENABLED=y

# FreeRTOS tick rate
CONFIG_FREERTOS_HZ=1000

# ログレベル
CONFIG_LOG_DEFAULT_LEVEL_WARN=y
```
